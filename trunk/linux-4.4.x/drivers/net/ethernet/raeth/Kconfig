## trunk/linux-4.4.x/drivers/net/ethernet/raeth/Kconfig
```kconfig
config RAETH
	tristate "Mediatek Ethernet GMAC"
	---help---
	  This driver supports Mediatek gigabit ethernet family of
	  adapters.

	  Note that the answer to this question doesn't directly affect the
	  kernel: saying N will just cause the configurator to skip all
	  the questions about Mediatek Ethernet devices. If you say Y,
	  you will be asked for your specific card in the following questions.

if RAETH

choice
	prompt "GMAC is connected to"
	depends on RAETH
	default GE1_RGMII_FORCE_1000

	config  GE1_MII_FORCE_100
		bool "MII_FORCE_100 (External 10/100M Switch)"
		depends on (RALINK_RT3883 || RALINK_MT7621)

	config  GE1_MII_AN
		bool "MII_AN (External 10/100M Phy)"
		depends on (RALINK_RT3883 || RALINK_MT7621)

	config  GE1_RVMII_FORCE_100
		bool "RvMII_FORCE_100 (External CPU)"
		depends on (RALINK_RT3883 || RALINK_MT7621)

	config  GE1_RGMII_FORCE_1000
		bool "RGMII_FORCE_1000 (External GigaSW, CPU)"
		depends on (RALINK_RT3883)

	config  GE1_RGMII_FORCE_1000
		bool "RGMII_FORCE_1000 (GE1 -> MT7530 GigaSW P6)"
		depends on (RALINK_MT7621)
		select MT7530_GSW

	config  GE1_TRGMII_FORCE_1200
		bool "TRGMII_FORCE_1200 (GE1 -> MT7530 GigaSW P6)"
		depends on (RALINK_MT7621)
		select MT7530_GSW

	config  GE1_RGMII_AN
		bool "RGMII_AN (External GigaPhy)"
		depends on (RALINK_RT3883 || RALINK_MT7621)

	config  GE1_RGMII_NONE
		bool "NONE (Not used)"
		depends on (RALINK_RT3883 || RALINK_MT7621)

	config  GE1_MAC_ESW
		bool "Integrated ESW"
		depends on (RALINK_RT3052 || RALINK_RT3352 || RALINK_RT5350 || RALINK_MT7620 || RALINK_MT7628)
		select RAETH_ESW if (RALINK_RT5350 || RALINK_MT7628)

	config  GE1_SGMII_FORCE_2500
		bool "SGMII_FORCE_2500 (GigaSW)"
		depends on (RALINK_MT7621)
		---help---
		  If you want to use sgmii force 2500.
		  Please enable GE1_SGMII_FORCE_2500.
		  Switch must support SGMII interface.
		  This config will impact switch app makefile.

endchoice

config ETH_SKB_ALLOC_SELECT
	bool "SKB Allocation API Select"

choice
	prompt "SKB Allocation API Selection"
	depends on ETH_SKB_ALLOC_SELECT
	default ETH_PAGE_ALLOC_SKB

config  ETH_SLAB_ALLOC_SKB
	bool "SLAB skb allocation"

config  ETH_PAGE_ALLOC_SKB
	bool "Page skb allocation"

endchoice

config RAETH_GMAC2
	bool "GMAC2 Support"
	depends on RAETH && (RALINK_RT3883 || RALINK_MT7621)

choice
	prompt "GMAC2 is connected to"
	depends on RAETH_GMAC2
	default GE2_RGMII_FORCE_1000

	config GE2_MII_FORCE_100
		bool "MII_FORCE_100 (External 10/100M Switch)"

	config GE2_MII_AN
		bool "MII_AN (External 100Phy)"

	config GE2_RVMII_FORCE_100
		bool "RvMII_FORCE_100 (External CPU)"

	config GE2_RGMII_FORCE_1000
		bool "RGMII_FORCE_1000 (External GigaSW, CPU)"

	config GE2_RGMII_AN
		bool "RGMII_AN (External GigaPhy)"

	config GE2_INTERNAL_GMAC_P5
		bool "Internal GigaSW (GE2 -> MT7530 GMAC P5)"
		depends on (RALINK_MT7621)
		select MT7530_GSW

	config GE2_INTERNAL_GPHY_P4
		bool "Internal GigaPHY Port 4 (GE2 -> MT7530 P4 AN)"
		depends on (RALINK_MT7621)
		select MT7530_GSW

	config GE2_INTERNAL_GPHY_P0
		bool "Internal GigaPHY Port 0 (GE2 -> MT7530 P0 AN)"
		depends on (RALINK_MT7621)
		select MT7530_GSW
endchoice

config  RAETH_BOTH_GMAC
	bool
	default y if (RAETH_GMAC2 && !GE1_RGMII_NONE)
	depends on RAETH && RAETH_GMAC2

config  MT7530_GSW
	bool "MediaTek MT7530 Giga-Switch (On-die for MT7621)"
	depends on RAETH && (RALINK_MT7620 || RALINK_MT7621)

config  RAETH_ESW_CONTROL
	bool "Embedded (or MT7530) Switch Control Module (VLAN/Isolation/Status)"
	default y

choice
	prompt "IGMP/MLD snooping support"
	depends on RAETH_ESW_CONTROL
	default RAETH_ESW_IGMP_SNOOP_HW

	config RAETH_ESW_IGMP_SNOOP_OFF
	bool "Disable IGMP/MLD snooping"

	config RAETH_ESW_IGMP_SNOOP_SW
	bool "Software mode IGMP/MLD snooping"
	depends on BRIDGE_IGMP_SNOOPING
	select BRIDGE_IGMP_EVENT_HOOK

	config RAETH_ESW_IGMP_SNOOP_HW
	bool "Hardware mode IGMP/MLD snooping"
	depends on !(RALINK_RT3052 || RALINK_RT3352 || RALINK_RT5350 || RALINK_MT7628)
endchoice

config  RAETH_ESW_PORT_WAN
	int "ESW WAN Port ID (0..4)"
	depends on RAETH_ESW_CONTROL
	default 4

config  RAETH_ESW_PORT_LAN1
	int "ESW LAN1 Port ID (0..4)"
	depends on RAETH_ESW_CONTROL
	default 0

config  RAETH_ESW_PORT_LAN2
	int "ESW LAN2 Port ID (0..4)"
	depends on RAETH_ESW_CONTROL
	default 1

config  RAETH_ESW_PORT_LAN3
	int "ESW LAN3 Port ID (0..4)"
	depends on RAETH_ESW_CONTROL
	default 2

config  RAETH_ESW_PORT_LAN4
	int "ESW LAN4 Port ID (0..4)"
	depends on RAETH_ESW_CONTROL
	default 3

endif 	# RAETH
```
